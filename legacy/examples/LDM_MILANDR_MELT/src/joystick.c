/*============================================================================================
 *
 *  (C) 2013, LDM-SYSTEMS
 *
 *  Демонстрационный проект для отладочной платы LDM-K1986BE92QI
 *
 *  Данное ПО предоставляется "КАК ЕСТЬ", т.е. исключительно как пример, призванный облегчить
 *  пользователям разработку их приложений для процессоров Milandr K1986BE92QI. Компания LDM-SYSTEMS
 *  не несет никакой ответственности за возможные последствия использования данного, или
 *  разработанного пользователем на его основе, ПО.
 *
 *--------------------------------------------------------------------------------------------
 *
 *  Файл joystick.c: Работа с набором кнопок ("джойстиком")
 *
 *============================================================================================*/

#include <joystick.h>

/* Маски и соответствие "кодам клавиш" */

#define No_Key_Pressed      0x7C00

/*static uc32 KeyMasks[NUM_KEY_CODES] = {
        No_Key_Pressed, /* NOKEY    */
        0x7800,         /* SEL      */
        0x3C00,         /* RIGHT    */
        0x5C00,         /* LEFT     */
        0x7400,         /* UP       */
        0x6C00          /* DOWN     */
}; */

void InitPortJoystick(void) {
    PORTB->FUNC  &= ~((0xF << (5 << 1)));   /* Main Function для UP - PB5, RIGNHT - PB6 */
    PORTB->ANALOG |= 0x3 << 5;     /* Digital */

    PORTC->FUNC &= ~((0x3 << (2 << 1)));   /* Main Function для SEL - PC2 */
    PORTC->ANALOG |= 0x1 << 2;     /* Digital */

    PORTE->FUNC &= ~((0b110011 << (1 << 1)));   /* Main Function для DOWN - PE1, LEFT - PE3*/
    PORTE->ANALOG |= 0x5 << 1;     /* Digital */
}

/* Определение "кода" по нажатым кнопкам */
KeyCode GetKey(void) {
    u32 i, sKey;
    u32 data[5];



    for(i=0;i<5;i++)
    {
      data[i] = 1;
    }

    // Собираем данные с кнопок в массив с инверсией  значений (1 - нажата, 0 - не нажата)
    if(PORTC->RXTX & (1<<2)) data[0] = 0;   /* SEL      PC2*/
    if(PORTB->RXTX & (1<<6)) data[1] = 0;   /* RIGHT    PB6*/
    if(PORTE->RXTX & (1<<3)) data[2] = 0;   /* LEFT     PE3*/
    if(PORTB->RXTX & (1<<5)) data[3] = 0;   /* UP       PB5*/
    if(PORTE->RXTX & (1<<1)) data[4] = 0;   /* DOWN     PE1*/

    // Суммируем состояния кнопок
    sKey=0;
    for(i=0;i<5;i++)
    {
      sKey = sKey + data[i];
    }

    if(sKey == 0) /* NOKEY    */
    {
      return NOKEY;
    }
    else if(sKey > 1)  /* MULTIPLE */
    {
      return MULTIPLE;
    }

    // Если нажата только одна кнопка, то распознаем её
    for(i=0;i<5;i++)
    {
      if(data[i] == 1)
      {
        return ((KeyCode)(i+1));
      }
    }
}

/*============================================================================================
 * Конец файла joystick.c
 *============================================================================================*/

